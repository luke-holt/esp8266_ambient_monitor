## main/Kconfig.projbuild
```kconfig
menu "WiFi configuration"

    config WIFI_SSID
        string "network name"

    config WIFI_PASS
        string "Network password"

endmenu

menu "MQTT configuration"

    config ESP_MQTT_URI
        string "URI to MQTT broker"

endmenu

menu "I2C configuration"

    config I2C_MASTER_SDA_IO
        int "GPIO pin for I2C data line"
        default 14
    
    config I2C_MASTER_SCL_IO
        int "GPIO pin for I2C clock line"
        default 2

endmenu
```
